## main/Kconfig.projbuild
```kconfig
menu "Panasonic CZ-TACG1"

config PANASONIC_UART_TX_GPIO
    int "UART TX GPIO (ESP TX -> AC RX)"
    default 5
    range 0 30
    help
        GPIO that drives the air conditioner RX line through a 3.3 V to 5 V
        level shifter. ESP32-C6 and ESP32-H2 devkits can use the default.

config PANASONIC_UART_RX_GPIO
    int "UART RX GPIO (ESP RX <- AC TX)"
    default 8
    range 0 30
    help
        GPIO that receives the air conditioner TX line through the level shifter.
        On ESP32-C6, GPIO8 is a ROM-log strap. An idle-high UART is fine.
        A level shifter that pulls this pin low at reset silences the ROM log.
        GPIO9 is the BOOT strap; the shifter must not drive it.

config PANASONIC_FACTORY_RESET_GPIO
    int "Factory reset button GPIO (active low)"
    default 9
    range 0 30
    help
        Hold this pin low for 5 seconds to leave the Zigbee network.
        GPIO9 is the BOOT button on most ESP32-C6 and ESP32-H2 boards.

config PANASONIC_INDOOR_OFFSET
    int "Indoor temperature offset (degree C)"
    default 0
    range -10 10
    help
        Added to the indoor temperature reported by the AC, and subtracted
        from the target temperature sent to the AC.

config PANASONIC_OUTDOOR_OFFSET
    int "Outdoor temperature offset (degree C)"
    default 0
    range -10 10

endmenu
```

## sdkconfig.defaults
```kconfig
# Zigbee router. The module is mains-powered by the indoor unit.
CONFIG_ZB_ENABLED=y
CONFIG_ZB_ZED=n
CONFIG_ZB_ZCZR=y
CONFIG_ZB_RADIO_NATIVE=y

CONFIG_ESP_ZB_ENABLE=y
CONFIG_ESP_ZB_DEVICE_TYPE_ZED=n
CONFIG_ESP_ZB_DEVICE_TYPE_ZR=y
CONFIG_ESP_ZB_DEVICE_TYPE_ZC=n
CONFIG_ESP_ZB_RADIO_USE_NATIVE=y
CONFIG_ESP_ZB_RADIO_UART=n
CONFIG_ESP_ZB_FLASH_NVRAM_ENABLED=y

# A router stays awake and relays the mesh.
CONFIG_PM_ENABLE=n
CONFIG_FREERTOS_USE_TICKLESS_IDLE=n
CONFIG_FREERTOS_HZ=1000
CONFIG_IEEE802154_SLEEP_ENABLE=n

CONFIG_COMPILER_OPTIMIZATION_SIZE=y
CONFIG_PARTITION_TABLE_CUSTOM=y
CONFIG_PARTITION_TABLE_CUSTOM_FILENAME="partitions.csv"
CONFIG_PARTITION_TABLE_FILENAME="partitions.csv"

CONFIG_ESPTOOLPY_FLASHMODE_DIO=y
CONFIG_ESPTOOLPY_FLASHSIZE_2MB=y
CONFIG_ESPTOOLPY_FLASHSIZE="2MB"
```
